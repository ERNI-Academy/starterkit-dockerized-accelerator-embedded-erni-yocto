## meta-erni/conf/layer.conf
```bitbake
# We have a conf and classes directory, append to BBPATH
BBPATH .= ":${LAYERDIR}"

# We have a recipes directory containing .bb and .bbappend files, add to BBFILES
BBFILES += "${LAYERDIR}/recipes*/*/*.bb \
            ${LAYERDIR}/recipes*/*/*.bbappend"

BBFILE_COLLECTIONS += "erni"
BBFILE_PATTERN_erni := "^${LAYERDIR}/"
BBFILE_PRIORITY_erni = "9"

LAYERSERIES_COMPAT_erni = "honister"
LAYERDEPENDS_erni = "raspberrypi"

# Additional license directories.
#LICENSE_PATH += "${LAYERDIR}/files/custom-licenses"
```
